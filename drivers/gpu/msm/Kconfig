## drivers/gpu/msm/Kconfig
```kconfig
config QCOM_KGSL
	tristate "Qualcomm Technologies, Inc. 3D Graphics driver"
	default n
	depends on ARCH_QCOM
	select GENERIC_ALLOCATOR
	select FW_LOADER
	select PM_DEVFREQ
	select DEVFREQ_GOV_SIMPLE_ONDEMAND
	select DEVFREQ_GOV_PERFORMANCE
	select DEVFREQ_GOV_QCOM_ADRENO_TZ
	select DEVFREQ_GOV_QCOM_GPUBW_MON
	---help---
	  3D graphics driver for the Adreno family of GPUs from QTI.
	  Required to use hardware accelerated OpenGL, compute and Vulkan
	  on QTI targets. This includes power management, memory management,
	  and scheduling for the Adreno GPUs.

config QCOM_ADRENO_DEFAULT_GOVERNOR
	string "devfreq governor for the adreno core"
	default "msm-adreno-tz" if DEVFREQ_GOV_QCOM_ADRENO_TZ
	default "simple_ondemand"
	depends on QCOM_KGSL

config QCOM_KGSL_IOMMU
	bool
	default y if QCOM_KGSL && (MSM_IOMMU || ARM_SMMU)

config NUBIA_LCD_KEEP_POWER_ON
	bool "lcd keep power on at suspend"
	default n
	---help---
	  incell panel needs lcd keep power on
	  while tp wakeup gesture enable.
```

## drivers/hwmon/nubia_sensors/Kconfig
```kconfig
################################################# SENROS START
menuconfig NUBIA_SENSORS
	tristate "NUBIA SENSORS ON"
	default n
	help
		nubia sensor
if NUBIA_SENSORS
config FEATURE_NUBIA_SENSORS_LOG_ON
	tristate "NUBIA SENSORS LOG ON"
	depends on NUBIA_SENSORS
	default n
	help
		If you want to enable the sensor log,

################################################# RGB START
config NUBIA_SENSORS_RGB_BH1745
	tristate "support rgb bh1745 driver"
	depends on NUBIA_SENSORS
	default n
	help
		nubia rgb device
################################################# HALL START
config NUBIA_SENSORS_HALL_DEVICE
	tristate "hall devicedriver"
	depends on NUBIA_SENSORS
	default n
	help
	  If you say yes here you get support for
	  hall device
################################################# AMS START
config NUBIA_SENSORS_TMD3702
	tristate "support litehole light/prox sensor driver"
	depends on NUBIA_SENSORS
	default n
	help
		nubia ambient&&prox device of tmd3702
################################################# OPTICAL_KEY_LEFT START
config NUBIA_SENSORS_OPTICAL_KEY_LEFT
	tristate "support optical key left pa224 driver"
	depends on NUBIA_SENSORS
	default n
	help
		nubia device of optical key left

################################################# OPTICAL_KEY_RIGHT START
config NUBIA_SENSORS_OPTICAL_KEY_RIGHT
	tristate "support optical key right pa224 driver"
	depends on NUBIA_SENSORS
	default n
	help
		nubia device of optical key right
################################################# VIRTUAL_PROXIMITY
config NUBIA_VIRTUAL_PROXIMITY
	tristate "support virtual proximity driver"
	depends on NUBIA_SENSORS
	default n
	help
		nubia device of virtual proximity
################################################# PROX_PA224
config NUBIA_SENSORS_PROX_PA224
	tristate "support litehole prox sensor driver"
	depends on NUBIA_SENSORS
	default n
	help
		nubia prox device
################################################# AMS START
config NUBIA_SENSORS_TMD2725
	tristate "support litehole light/prox sensor driver"
	depends on NUBIA_SENSORS
	default n
	help
		nubia ambient&&prox device of tmd2725
################################################# DOUBLE_PROXIMITY
config NUBIA_DOUBLE_PROXIMITY
	tristate "support double proximity driver"
	depends on NUBIA_SENSORS
	default n
	help
		nubia device of double proximity

endif
```

## drivers/leds/nubia_led/tfa9xxx/Kconfig
```kconfig
#
# nubia led aw9106 driver configuration
#

config NUBIA_LED_TFA9XXX
	bool "nubia led tfa9xxx driver"
	default n
	help
	  Say Y here if you have a nubia led aw22xxx connected
	  to your system.

	  If unsure, say N.
```

## drivers/media/platform/msm/Kconfig
```kconfig
#
# MSM camera configuration
#

comment "Qualcomm Technologies, Inc. MSM Camera And Video"

menuconfig SPECTRA_CAMERA
    bool "Qualcomm Technologies, Inc. Spectra camera and video capture support"
    depends on ARCH_QCOM && VIDEO_V4L2 && I2C
    ---help---
      Say Y here to enable selecting the video adapters for
      Qualcomm Technologies, Inc. Spectra camera and video capture.
      Enabling this adds support for the camera driver stack including sensor,
      IFE and postprocessing drivers.

config NUBIA_CAMERA_DUAL_CAMERA_IMX519
    bool "nubia enable dualcamera imx519"
    default n
    help
        NX616 imx519 eeprom dualcamera cal addr is different from imx499
		  
source "drivers/media/platform/msm/vidc/Kconfig"

source "drivers/media/platform/msm/sde/Kconfig"
source "drivers/media/platform/msm/dvb/Kconfig"
source "drivers/media/platform/msm/broadcast/Kconfig"
```

## drivers/nubia/Kconfig
```kconfig
#
# Nubia drivers configuration
#

#menuconfig NUBIA_DRIVERS
menu "nubia drivers"

config NUBIA_DRIVERS
	bool "NUBIA DRIVERS"
	default n
	help
	  Say Y here if you want to enable NUBIA DRIVERS
	  If unsure, say N.

comment "Nubia Device Drivers"

if NUBIA_DRIVERS

config NUBIA_FINGERPRINT
	bool "NUBIA_FINGERPRINT"
	default n
	help
	 Say Y here if you have enable NUBIA_FINGERPRINT
	 IF  unsure ,say N

+config NUBIA_TOUCH
	bool "NUBIA_TOUCH"
	default n
	help
	 Say Y here if you have enable NUBIA_FINGERPRINT
	 IF  unsure ,say N

endif


if NUBIA_FINGERPRINT
source "drivers/nubia/fingerprint/Kconfig"
endif

if NUBIA_TOUCH
source "drivers/nubia/touch/Kconfig"
endif

endmenu
```

## drivers/nubia/fingerprint/Kconfig
```kconfig
################################################# FINGER_PRINTER START
config  NUBIA_SENSORS_FP
	tristate "NUBIA FP DEVICE"
	default n

if NUBIA_SENSORS_FP

################################################# FINGER_PRINTER_GF5216M START
source drivers/nubia/fingerprint/gf5288/Kconfig
choice
        prompt "choose the GF5216M device style"
        depends on NUBIA_SENSORS_FP_GF5288
        default NUBIA_SENSORS_FP_GF5288_PLATFORM
        help
           GF5216M need to select the work style

config NUBIA_SENSORS_FP_GF5288_SPI
        bool "GF5216M work as SPI device"
        help
          If you want GF5216M work as SPI device, select it.

config NUBIA_SENSORS_FP_GF5288_PLATFORM
        bool "GF5216M work as PLATFORM device"
        help
          If you want GF5216M work as PLATFORM device, select it.

endchoice
################################################# FINGER_PRINTER_GF5216M END

source drivers/nubia/fingerprint/gf3266/Kconfig
source drivers/nubia/fingerprint/gf5288_right/Kconfig
source drivers/nubia/fingerprint/gf5288_left/Kconfig
choice
        prompt "choose the GF5216M device style"
        depends on NUBIA_SENSORS_FP_GF5288_RIGHT
        default NUBIA_SENSORS_FP_GF5288_RIGHT_PLATFORM
        help
           GF5216M need to select the work style

config NUBIA_SENSORS_FP_GF5288_RIGHT_SPI
        bool "GF5216M work as SPI device"
        help
          If you want GF5216M work as SPI device, select it.

config NUBIA_SENSORS_FP_GF5288_RIGHT_PLATFORM
        bool "GF5216M work as PLATFORM device"
        help
          If you want GF5216M work as PLATFORM device, select it.

endchoice
choice
        prompt "choose the GF5216M device style"
        depends on NUBIA_SENSORS_FP_GF5288_LEFT
        default NUBIA_SENSORS_FP_GF5288_LEFT_PLATFORM
        help
           GF5216M need to select the work style

config NUBIA_SENSORS_FP_GF5288_LEFT_SPI
        bool "GF5216M work as SPI device"
        help
          If you want GF5216M work as SPI device, select it.

config NUBIA_SENSORS_FP_GF5288_LEFT_PLATFORM
        bool "GF5216M work as PLATFORM device"
        help
          If you want GF5216M work as PLATFORM device, select it.

endchoice
endif
```

## drivers/nubia/fingerprint/gf3266/Kconfig
```kconfig
config NUBIA_SENSORS_FP_GF3266
	tristate "nubia sensors fp gf3266"
	depends on NUBIA_SENSORS_FP
	default n
	help
	  This is the main file for fingerprint driver for gf3266.
	  Say Y here if you have a gf5216m fingerprint connected
	  to your system.
```

## drivers/nubia/fingerprint/gf5288_left/Kconfig
```kconfig
config NUBIA_SENSORS_FP_GF5288_LEFT
	tristate "nubia sensors fp gf5288"
	depends on NUBIA_SENSORS_FP
	default n
	help
	  This is the main file for fingerprint driver for gf5288.
	  Say Y here if you have a gf5216m fingerprint connected
	  to your system.
```

## drivers/nubia/touch/Kconfig
```kconfig
config  NUBIA_TOUCH_GOODIX
	tristate "NUBIA GOODIX DEVICE"
	default n

config NUBIA_TOUCHSCREEN_HXCHIPSET
	tristate "NUBIA HIMAX DEVICE"
	default n
	
if NUBIA_TOUCH_GOODIX
source drivers/nubia/touch/goodix_gtx8-1.2/Kconfig
endif

if NUBIA_TOUCHSCREEN_HXCHIPSET
source "drivers/nubia/touch/hxchipset/Kconfig"
endif
```

## drivers/nubia/touch/hxchipset/Kconfig
```kconfig
#
# Himax Touchscreen driver configuration
#

config TOUCHSCREEN_HIMAX_I2C
        tristate "HIMAX chipset i2c touchscreen"
		depends on NUBIA_TOUCHSCREEN_HXCHIPSET
		help
		This enables support for HIMAX CHIPSET over I2C based touchscreens.

config TOUCHSCREEN_HIMAX_DEBUG
        tristate "HIMAX debug function"
		depends on TOUCHSCREEN_HIMAX_I2C
		help
		This enables support for HIMAX debug function.

#config TOUCHSCREEN_HIMAX_ITO_TEST
#	tristate "HIMAX driver test over Dragon Board"
#	depends on TOUCHSCREEN_HIMAX_I2C
#	help
#	  This enables support for HIMAX driver test over Dragon Board.

config HMX_DB
	tristate "HIMAX driver test over Dragon Board"
	depends on TOUCHSCREEN_HIMAX_I2C
	help
	  This enables support for HIMAX driver test over Dragon Board.

config NUBIA_TP_HIMAX_REPAIRED_BUG
	tristate "HIMAX driver repaired bug by NUBIA"
	depends on TOUCHSCREEN_HIMAX_I2C
	help
	  This enables support for HIMAX driver repaired bug by NUBIA.
```
