
qcom,atl_3800mah_step {
	qcom, = <24>;
	qcom,max-voltage-uv = <4400000>;
	qcom,fg-cc-cv-threshold-mv = <4390>;
	qcom,nom-batt-capacity-mah = <3800>;
	qcom,batt-id-kohm = <15>;
	qcom,battery-beta = <4050>;
	qcom,battery-type = "atl_3800mah_step";
	qcom,checksum = <0x4BB9>;
	qcom,gui-version = "PMI8998GUI - 2.0.0.58";
	qcom,fg-profile-data = [
		 91 1F 84 05
		 A2 0A 18 06
		 DB 1C FC 01
		 B9 0D A5 0A
		 63 17 E0 23
		 8E 44 18 5A
		 74 00 00 00
		 11 00 00 00
		 00 00 EA CD
		 FC 07 8B D2
		 25 00 08 00
		 8A EA BB EC
		 09 06 3A 01
		 01 F3 0D 1A
		 40 07 76 32
		 22 06 09 20
		 27 00 14 00
		 C3 20 63 04
		 69 0B 61 05
		 DD 1C A7 02
		 B3 0C 7C 0B
		 95 18 98 23
		 52 44 9B 5A
		 77 00 00 00
		 0F 00 00 00
		 00 00 DC D5
		 48 C2 86 CA
		 1C 00 00 00
		 01 F2 BB EC
		 E6 06 33 F2
		 A5 F5 EF 02
		 5D E5 91 1B
		 B0 33 CC FF
		 07 10 00 00
		 A3 0E 66 46
		 1C 00 40 00
		 6F 01 0A FA
		 FF 00 00 00
		 00 00 00 00
		 00 00 00 00
		 00 00 00 00
		 00 00 00 00
		 00 00 00 00
		 00 00 00 00
		 00 00 00 00
		 00 00 00 00
		 00 00 00 00
		 00 00 00 00
		 00 00 00 00
		 00 00 00 00
		 00 00 00 00
		 00 00 00 00
		 00 00 00 00
		 00 00 00 00
		 00 00 00 00
		 00 00 00 00
	];
};
